# C64 register map
Vendor: Commodore Business Machines; Series: Commodore 64; File version: 0.1.0
Commodore 64 memory-mapped I/O: MOS 6510 on-chip port, VIC-II (6567 NTSC / 6569 PAL), SID (6581/8580), CIA1/CIA2 (6526), and color RAM. Assumptions and limits of this description: 1. The map below is only visible when the PLA banks I/O in: CPUPORT.R6510 bit CHAREN=1 and not (LORAM=0 and HIRAM=0), with EXROM/GAME inactive (no cartridge). With CHAREN=0 the character ROM appears at 0xD000-0xDFFF instead; with LORAM=HIRAM=0 it is RAM. SVD has no way to express this banking; software must own the CPUPORT.R6510 state. 2. Register images repeat within each chip's page: VIC-II every 0x40 bytes in 0xD000-0xD3FF, SID every 0x20 in 0xD400-0xD7FF, each CIA every 0x10 in its page. Registers are described once at the base image. 3. Interrupts: the 6510 has fixed-vector IRQ (0xFFFE) and NMI (0xFFFA); there is no NVIC, so no interrupt elements are declared. VIC-II and CIA1 assert IRQ; CIA2 and the RESTORE key assert NMI. With KERNAL banked in, vectors indirect through RAM at 0x0314/0x0316/0x0318. 4. PHI2 = 985248 Hz (PAL) / 1022727 Hz (NTSC); CIA timers count PHI2. 5. Power-on register state is undefined unless a chip specifies otherwise; resetMask=0 encodes that. 6. ROM and RAM conventions are out of scope for an SVD: BASIC ROM 0xA000-0xBFFF, KERNAL ROM 0xE000-0xFFFF, character ROM at 0xD000 when CHAREN=0, the KERNAL's default screen at 0x0400, and sprite shape pointers at screen+0x3F8 (fetched by VIC DMA) belong to a BSP layer. 7. Bus stalls are not modeled: the VIC halts CPU reads via BA/
CPU: other r0p0, little endian, no MPU, no FPU, 2 interrupt priority bits
Registers are 8-bit, read-write, no defined reset value unless marked. A register's access mark holds for its fields unless they carry their own. Offsets are from the block's base; lines under a group give offsets from that group; [hi:lo] are bit positions; {n}, {i} and the like mark numbered series; 'fields as' and 'values as' point back to an identical list; <NAME> marks a mode.

## Memory map
0x00000000 CPUPORT size 0x2 — MOS 6510 on-chip I/O port at addresses 0x0000-0x0001: memory banking control and Datassette lines. KERNAL reset writes D6510=0x2F, R6510=0x37. baseAddress 0 puts D6510 at address 0, where the generated Periph Deref would form a null reference, so this peripheral is hand-written over the generated output by svd/generate_c64_pac.sh, Fix 5.
0x0000D000 VIC size 0x40 — VIC-II video interface (6567 NTSC / 6569 PAL) at 0xD000. Register image repeats every 0x40 bytes through 0xD3FF. Unimplemented bits read as 1. Addresses 0xD02F-0xD03F are not implemented on the 6567/6569: they read 0xFF and writes have no effect. Caveat: on a C128 in C64 mode, the VIC-IIe does implement 0xD02F (extended keyboard lines) and 0xD030 (2 MHz clock control) at these addresses. The VIC addresses 16 KiB selected by CIA2.CI2PRA bits 0-1. IRQ output drives the 6510 IRQ line.
0x0000D400 SID size 0x20 — SID sound interface (6581/8580) at 0xD400. Register image repeats every 0x20 bytes through 0xD7FF. Voice and filter registers are write-only: reads return a decaying copy of the last value written to any SID register, not register contents (not modeled here). POTX/POTY digitize the RC discharge time of the paddle inputs selected by CIA1.CIAPRA bits 6-7.
0x0000D800 COLORRAM size 0x400 — 1024 nybbles of static color RAM at 0xD800-0xDBFF, always visible when I/O is banked in, independent of the VIC bank. Only bits 3:0 are stored; bits 7:4 read as whatever the VIC last placed on its data bus (treat reads as 4-bit). The first 1000 (0xD800-0xDBE7) back the 40x25 text/bitmap display; the remaining 24 (0xDBE8-0xDBFF) are unused by the VIC but are real 4-bit cells, usable as scratch.
0x0000DC00 CIA1 size 0x10 — MOS 6526 CIA 1 at 0xDC00 (image repeats every 0x10 bytes through 0xDCFF): keyboard matrix, joysticks, paddle select, Datassette read (FLAG1), timers. IRQ output drives the 6510 IRQ line. TOD pin receives mains-derived 50/60 Hz. SP1/CNT1 are available on the user port.
0x0000DD00 CIA2 size 0x10 — MOS 6526 CIA 2 at 0xDD00 (image repeats every 0x10 bytes through 0xDDFF): VIC bank select, IEC serial bus, user port, RS-232. IRQ output drives the 6510 NMI line (shared with the RESTORE key). FLAG2 is user port pin B (RS-232 RXD). SP2/CNT2 are available on the user port. Defined in full rather than derived from CIA1 so port and FLAG descriptions are correct; register layout is identical to CIA1.
0x0000DE00 IO1 size 0x100 — Expansion (cartridge) port chip-select window: the PLA asserts /IO1 for any access in 0xDE00-0xDEFF. No on-board device responds; contents are defined by the inserted cartridge. With nothing connected, reads return open bus (a decaying copy of the last byte on the data bus) and writes have no effect.
0x0000DF00 IO2 size 0x100 — Expansion (cartridge) port chip-select window: the PLA asserts /IO2 for any access in 0xDF00-0xDFFF. Same behavior as IO1; commonly used by REU, disk speeders and other cartridges.

## Licence text in the file
Hardware register facts are public domain. This file: CC0-1.0.
